## drivers/can/Kconfig.sccan
```kconfig
# Space Cubics CAN configuration options

# Copyright (c) 2021 Space Cubics
# SPDX-License-Identifier: Apache-2.0

config CAN_SCCAN
	bool "Space Cubics CAN Driver"
	help
	  Enable Space Cubics CAN Driver.
```
